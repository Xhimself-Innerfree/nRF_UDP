## Sample_CLI/build/l5_e1_sol_2/Kconfig/Kconfig.shield
```kconfig
osource "D:/nRF_Projects/Cli_UDP/boards/shields/*/Kconfig.shield"
osource "D:/nRF_Projects/Cli_UDP_RCV/boards/shields/*/Kconfig.shield"
osource "D:/nRF_Projects/Cli_UART_2_UDP_RCP/boards/shields/*/Kconfig.shield"
osource "C:/ncs/v3.0.0/nrf/boards/shields/*/Kconfig.shield"
```

## Sample_RCP/build/l5_e1_sol/Kconfig/Kconfig.shield.defconfig
```kconfig
osource "D:/nRF_Projects/Cli_UDP/boards/shields/*/Kconfig.defconfig"
osource "D:/nRF_Projects/Cli_UDP_RCV/boards/shields/*/Kconfig.defconfig"
osource "D:/nRF_Projects/Cli_UART_2_UDP_RCP/boards/shields/*/Kconfig.defconfig"
osource "C:/ncs/v3.0.0/nrf/boards/shields/*/Kconfig.defconfig"
```
